/* Copyright (c) 2012-2013, The Linux Foundation. All rights reserved.
 *
 * This program is free software; you can redistribute it and/or modify
 * it under the terms of the GNU General Public License version 2 and
 * only version 2 as published by the Free Software Foundation.
 *
 * This program is distributed in the hope that it will be useful,
 * but WITHOUT ANY WARRANTY; without even the implied warranty of
 * MERCHANTABILITY or FITNESS FOR A PARTICULAR PURPOSE.  See the
 * GNU General Public License for more details.
 */

/dts-v1/;

/include/ "msm8974-v1-acer.dtsi"
/include/ "msm8974-acer-a12-evt1.dtsi"

/ {
	model = "Acer A12";
	compatible = "acer,hemingway", "qcom,msm8974", "qcom,cdp";
	acer,hw_ver = <0x2>;
	qcom,msm-id = <126 1 0>,
		      <185 1 0>,
		      <186 1 0>;
};

&ehci {
	status = "ok";
	vbus-supply = <&usb2_otg_sw>;
};

&hsic_host {
       qcom,phy-sof-workaround;
};
